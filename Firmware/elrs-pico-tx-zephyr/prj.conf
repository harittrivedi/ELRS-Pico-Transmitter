## CMakeLists.txt
```
# SPDX-License-Identifier: Apache-2.0

cmake_minimum_required(VERSION 3.20.0)

find_package(Zephyr REQUIRED HINTS $ENV{ZEPHYR_BASE})
project(elrs_pico_tx)

target_sources(app PRIVATE
    src/main.c
)
```

## prj.conf
```kconfig
# SPDX-License-Identifier: Apache-2.0
# ELRS Pico TX - Zephyr Configuration

# ============================================
# ============================================
# Core System
# ============================================
CONFIG_GPIO=y
CONFIG_LOG=y
CONFIG_LOG_DEFAULT_LEVEL=3

# Platform Drivers (Required for RP2350)
CONFIG_RESET=y
CONFIG_CLOCK_CONTROL=y

# AGGRESSIVE WARNING SUPPRESSION
# Ensure build passes even with Kconfig dependency noise
CONFIG_WARN_EXPERIMENTAL=n
CONFIG_WARN_DEPRECATED=n
CONFIG_COMPILER_WARNINGS_AS_ERRORS=n


# ============================================
# USB CDC ACM (Phase 2)
# ============================================
# CONFIG_USB_CDC_ACM=y
# CONFIG_SERIAL=y
# CONFIG_UART_LINE_CTRL=y
# CONFIG_USB_CDC_ACM_RINGBUF_SIZE=1024

# ============================================
# UART (Will use PIO instead in Phase 3)
# ============================================
# CONFIG_SERIAL=y
# CONFIG_UART_INTERRUPT_DRIVEN=y

# ============================================
# Flash/NVS (Future - calibration storage)
# ============================================
# CONFIG_NVS=y
# CONFIG_FLASH=y
# CONFIG_FLASH_MAP=y
```

## boards/rpi_pico2_rp2350a_m33.overlay
```dts
/*
 * SPDX-License-Identifier: Apache-2.0
 * 
 * Devicetree overlay for ELRS Pico TX on RP2350 (Pico 2)
 * 
 * Pin Assignments (matching original Arduino config):
 * - GP25: LED (onboard)
 * - GP0:  UART TX to ELRS module
 * - GP1:  UART RX from ELRS module
 * - GP10: Buzzer (future)
 */

/ {
    aliases {
        led0 = &led0;
    };

    leds {
        compatible = "gpio-leds";
        led0: led_0 {
            gpios = <&gpio0 25 GPIO_ACTIVE_HIGH>;
            label = "Onboard LED";
        };
    };
};

/* 
 * UART1 configuration - commented until PIO implementation
 * The standard UART cannot do inversion, so we'll use PIO
 */
/*
&uart1 {
    status = "okay";
    current-speed = <400000>;
    pinctrl-0 = <&uart1_default>;
    pinctrl-names = "default";
};
*/
```

## src/main.c
```c
/*
 * SPDX-License-Identifier: Apache-2.0
 * 
 * ELRS Pico TX - Zephyr RTOS Port
 * Phase 1: LED Blink Test
 * 
 * This validates the basic project setup and GPIO functionality.
 * LED Pattern:
 * - 3 fast blinks on boot (initialization complete)
 * - Slow blink (1s on / 1s off) in main loop
 */

#include <zephyr/kernel.h>
#include <zephyr/drivers/gpio.h>
#include <zephyr/logging/log.h>

LOG_MODULE_REGISTER(elrs_tx, LOG_LEVEL_INF);

/* LED configuration from devicetree */
#define LED0_NODE DT_ALIAS(led0)

#if !DT_NODE_HAS_STATUS(LED0_NODE, okay)
#error "LED0 node is not available in devicetree"
#endif

static const struct gpio_dt_spec led = GPIO_DT_SPEC_GET(LED0_NODE, gpios);

/* Boot indication: 3 fast blinks */
static void boot_blink(void)
{
    for (int i = 0; i < 3; i++) {
        gpio_pin_set_dt(&led, 1);
        k_msleep(100);
        gpio_pin_set_dt(&led, 0);
        k_msleep(100);
    }
    k_msleep(500);
}

int main(void)
{
    int ret;

    LOG_INF("ELRS Pico TX - Zephyr Port");
    LOG_INF("Phase 1: LED Blink Test");

    /* Initialize LED GPIO */
    if (!gpio_is_ready_dt(&led)) {
        LOG_ERR("LED device not ready");
        return -ENODEV;
    }

    ret = gpio_pin_configure_dt(&led, GPIO_OUTPUT_ACTIVE);
    if (ret < 0) {
        LOG_ERR("Failed to configure LED: %d", ret);
        return ret;
    }

    LOG_INF("LED initialized on GPIO %d", led.pin);

    /* Boot indication */
    boot_blink();
    LOG_INF("Boot sequence complete");

    /* Main loop - slow blink */
    while (1) {
        gpio_pin_toggle_dt(&led);
        k_msleep(1000);
    }

    return 0;
}
```
